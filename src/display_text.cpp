#include "display_text.h"
#include "display_graphics.h"
#include "display_hardware.h"
#include "pin_config.h"

namespace DisplayText {

// 5x7 font table adapted from the Adafruit GFX library (MIT License).
//
// Permission is hereby granted, free of charge, to any person obtaining a copy
// of this software and associated documentation files (the "Software"), to deal
// in the Software without restriction, including without limitation the rights
// to use, copy, modify, merge, publish, distribute, sublicense, and/or sell
// copies of the Software, and to permit persons to whom the Software is
// furnished to do so, subject to the following conditions:
//
// The above copyright notice and this permission notice shall be included in
// all copies or substantial portions of the Software.
const uint8_t kFont5x7[95][5] PROGMEM = {
  {0x00, 0x00, 0x00, 0x00, 0x00}, // 0x20 ' '
  {0x00, 0x00, 0x5F, 0x00, 0x00}, // 0x21 '!'
  {0x00, 0x07, 0x00, 0x07, 0x00}, // 0x22 '"'
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  {0x08, 0x04, 0x08, 0x10, 0x08}, // 0x7E '~'
};

const size_t kFontGlyphCount = sizeof(kFont5x7) / sizeof(kFont5x7[0]);

}  // namespace DisplayText

// Text rendering implementation for T_Display_S3_Class

size_t T_Display_S3_Class::write(uint8_t c) {
  Serial.write(c);

  if (!panel_handle) {
    return 1;
  }

  if (c == '\r') {
    return 1;
  }

  if (c == '\n') {
    newLine();
    return 1;
  }

  if (c == '\t') {
    constexpr uint8_t kTabSize = 4;
    for (uint8_t i = 0; i < kTabSize; ++i) {
      write(' ');
    }
    return 1;
  }

  if (cursor_x_ + kGlyphWidth > EXAMPLE_LCD_H_RES) {
    newLine();
  }

  if (cursor_y_ + kGlyphHeight > EXAMPLE_LCD_V_RES) {
    clear();
  }

  if (!drawGlyph(static_cast<char>(c))) {
    drawGlyph('?');
  }

  cursor_x_ += kGlyphWidth;
  return 1;
}

void T_Display_S3_Class::newLine() {
  cursor_x_ = 0;
  cursor_y_ += kGlyphHeight;
  if (cursor_y_ + kGlyphHeight > EXAMPLE_LCD_V_RES) {
    clear();
  }
}

bool T_Display_S3_Class::drawGlyph(char c) {
  char glyph = c;
  if (glyph < 32 || glyph > 126) {
    glyph = '?';
  }

  const int index = glyph - 32;
  if (index < 0 || index >= static_cast<int>(DisplayText::kFontGlyphCount)) {
    return false;
  }

  for (int col = 0; col < 5; ++col) {
    const uint8_t column_bits = pgm_read_byte(&DisplayText::kFont5x7[index][col]);
    for (int row = 0; row < 7; ++row) {
      const bool pixel_on = column_bits & (1 << row);
      drawPixel(cursor_x_ + col, cursor_y_ + row, pixel_on ? text_color_ : bg_color_);
    }
    // fill vertical spacing pixel
    drawPixel(cursor_x_ + col, cursor_y_ + 7, bg_color_);
  }

  // trailing column of spacing
  for (int row = 0; row < kGlyphHeight; ++row) {
    drawPixel(cursor_x_ + 5, cursor_y_ + row, bg_color_);
  }

  return true;
}
